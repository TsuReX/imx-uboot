## board/atb/Kconfig
```kconfig
if TARGET_ATB_VAR_SOM

config SYS_VENDOR
	string
	default "atb"

config SYS_BOARD
	default "atb_var_som"

endif
```

## board/atb/atb_imx8m_smarc/Kconfig
```kconfig
if TARGET_ATB_IMX8M_SMARC

config SYS_BOARD
	default "atb_imx8m_smarc"

config SYS_VENDOR
	default "atb"

config SYS_CONFIG_NAME
	default "atb_imx8m_smarc"

source "board/freescale/common/Kconfig"

endif
```

## board/atb/atb_imx8mp_som/Kconfig
```kconfig
if TARGET_ATB_IMX8MP_SOM

config SYS_BOARD
	default "atb_imx8mp_som"

config SYS_VENDOR
	default "atb"

config SYS_CONFIG_NAME
	default "atb_imx8mp_som"

source "board/freescale/common/Kconfig"

endif
```

## board/atb/atb_var_som/Kconfig
```kconfig
if TARGET_ATB_VAR_SOM

config SYS_BOARD
	default "atb_var_som"

config SYS_VENDOR
	default "atb"

config SYS_CONFIG_NAME
	default "atb_var_som"

source "board/freescale/common/Kconfig"

endif
```
